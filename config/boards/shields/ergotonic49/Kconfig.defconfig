## config/boards/shields/ergotonic49/Kconfig.defconfig
```kconfig
# Copyright (c) 2021 The ZMK Contributors
# SPDX-License-Identifier: MIT

if SHIELD_ERGOTONIC49

config ZMK_KEYBOARD_NAME
    default "Ergotonic49"

# Enabling the composite kscan driver
config ZMK_KSCAN_COMPOSITE_DRIVER
	default y

endif
```
